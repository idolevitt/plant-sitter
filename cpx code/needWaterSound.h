/*
 * This file is responsible for making the ciruit express say "water me"
 */
 
#include <Wire.h>
#include <SPI.h>

const uint8_t spWATER[]         PROGMEM = {0xAA, 0x15, 0x7A, 0x23, 0x5C, 0x12, 0xE9, 0xD1, 0x0D, 0x5A, 0x76, 0x75, 0xB2,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 0xFF, 0x0F};

const uint8_t spME[]         PROGMEM = {0xA1, 0x8F, 0x5C, 0xB5, 0x56, 0x92, 0xE4, 0xE1, 0xF4, 0xDD, 0x0B, 0x59, 0x6B, 0xE3, 0x53, 0x8C, 0x14, 0x44, 0x15, 0x8B, 0x46, 0x3A, 0xB3, 0x03, 0x7B, 0xBE, 0x99, 0x89, 0x49, 0xB7, 0x72, 0xC4, 0xEA, 0x4C};

void playWaterMeSound();
void sosMessage(int value);

/*
    plays "WATER ME"
*/
void playWaterMeSound() {
  SerialMon.println(" fail");
  CircuitPlayground.speaker.say(spWATER);
  delay(300);
  CircuitPlayground.speaker.say(spME);
  CircuitPlayground.speaker.end();
}

/*
    plays "WATER ME" and blinks red lights
*/
void sosMessage() {
  playWaterMeSound();
  for (int j = 0; j < 5; ++j) {
    for (int i = 0; i < 10; ++i) {
      CircuitPlayground.setPixelColor(i, 255, 0, 0);
    }
    delay(500);
    for (int i = 0; i < 10; ++i) {
      CircuitPlayground.setPixelColor(i, 0, 0, 0);
    }
    delay(500);
  }
  playWaterMeSound();
}
